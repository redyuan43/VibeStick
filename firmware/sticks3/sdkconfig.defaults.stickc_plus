## firmware/sticks3/sdkconfig.defaults.stickc_plus
```kconfig
CONFIG_IDF_TARGET="esp32"
CONFIG_IDF_TARGET_ESP32=y
CONFIG_ESPTOOLPY_FLASHSIZE_4MB=y

# CONFIG_PARTITION_TABLE_SINGLE_APP is not set
# CONFIG_PARTITION_TABLE_SINGLE_APP_LARGE is not set
CONFIG_PARTITION_TABLE_CUSTOM=y
CONFIG_PARTITION_TABLE_CUSTOM_FILENAME="partitions_ota_1700k.csv"
CONFIG_PARTITION_TABLE_FILENAME="partitions_ota_1700k.csv"
```

## firmware/sticks3/sdkconfig.defaults.stickc_plus_minijoy_bt
```kconfig
CONFIG_IDF_TARGET="esp32"
CONFIG_IDF_TARGET_ESP32=y
CONFIG_ESPTOOLPY_FLASHSIZE_4MB=y

# Keep the normal StickC OTA-compatible flash layout. Wi-Fi starts only when
# the user requests the dedicated maintenance-mode OTA flow at boot.
# CONFIG_PARTITION_TABLE_SINGLE_APP is not set
# CONFIG_PARTITION_TABLE_SINGLE_APP_LARGE is not set
CONFIG_PARTITION_TABLE_CUSTOM=y
CONFIG_PARTITION_TABLE_CUSTOM_FILENAME="partitions_ota_1948k.csv"
CONFIG_PARTITION_TABLE_FILENAME="partitions_ota_1948k.csv"

CONFIG_BT_ENABLED=y
CONFIG_BT_BLUEDROID_ENABLED=y
CONFIG_BT_CLASSIC_ENABLED=y
# CONFIG_BT_BLE_ENABLED is not set
CONFIG_BTDM_CTRL_MODE_BR_EDR_ONLY=y
CONFIG_BTDM_CTRL_BR_EDR_MAX_SYNC_CONN=1
CONFIG_BT_HFP_ENABLE=y
CONFIG_BT_HFP_CLIENT_ENABLE=y
# CONFIG_BT_HFP_AG_ENABLE is not set
CONFIG_BT_HFP_AUDIO_DATA_PATH_HCI=y
# CONFIG_BT_HFP_AUDIO_DATA_PATH_PCM is not set
# CONFIG_BT_HFP_USE_EXTERNAL_CODEC is not set
CONFIG_BT_HFP_WBS_ENABLE=y
CONFIG_BT_HID_ENABLED=y
CONFIG_BT_HID_DEVICE_ENABLED=y
# CONFIG_BT_HID_HOST_ENABLED is not set
CONFIG_BT_HID_REMOVE_DEVICE_BONDING_ENABLED=y
# Wi-Fi remains an ESP-IDF build component, but this target never initializes it.
```

## firmware/sticks3/sdkconfig.defaults.stickc_plus_se
```kconfig
CONFIG_IDF_TARGET="esp32"
CONFIG_IDF_TARGET_ESP32=y
CONFIG_ESPTOOLPY_FLASHSIZE_4MB=y

# M5StickC Plus SE has the same 4MB flash layout as Plus 1.1.
# CONFIG_PARTITION_TABLE_SINGLE_APP is not set
# CONFIG_PARTITION_TABLE_SINGLE_APP_LARGE is not set
CONFIG_PARTITION_TABLE_CUSTOM=y
CONFIG_PARTITION_TABLE_CUSTOM_FILENAME="partitions_ota_1700k.csv"
CONFIG_PARTITION_TABLE_FILENAME="partitions_ota_1700k.csv"
```

## firmware/sticks3/sdkconfig.defaults.sticks3
```kconfig
CONFIG_IDF_TARGET="esp32s3"
CONFIG_IDF_TARGET_ESP32S3=y
CONFIG_ESPTOOLPY_FLASHFREQ_40M=y
CONFIG_ESPTOOLPY_FLASHSIZE_8MB=y

CONFIG_SPIRAM=y
CONFIG_SPIRAM_MODE_OCT=y
CONFIG_SPIRAM_SPEED_80M=y
CONFIG_SPIRAM_USE_MALLOC=y

# CONFIG_PARTITION_TABLE_SINGLE_APP is not set
# CONFIG_PARTITION_TABLE_SINGLE_APP_LARGE is not set
CONFIG_PARTITION_TABLE_CUSTOM=y
CONFIG_PARTITION_TABLE_CUSTOM_FILENAME="partitions_ota_1800k.csv"
CONFIG_PARTITION_TABLE_FILENAME="partitions_ota_1800k.csv"
```
